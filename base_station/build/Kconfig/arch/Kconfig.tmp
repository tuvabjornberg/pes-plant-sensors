## base_station/build/Kconfig/arch/Kconfig.tmp
```kconfig
# Load Zephyr Arch Kconfig descriptions.
osource "/Users/alfred/zephyrproject/zephyr/arch/rx/Kconfig"
osource "/Users/alfred/zephyrproject/zephyr/arch/x86/Kconfig"
osource "/Users/alfred/zephyrproject/zephyr/arch/xtensa/Kconfig"
osource "/Users/alfred/zephyrproject/zephyr/arch/sparc/Kconfig"
osource "/Users/alfred/zephyrproject/zephyr/arch/riscv/Kconfig"
osource "/Users/alfred/zephyrproject/zephyr/arch/posix/Kconfig"
osource "/Users/alfred/zephyrproject/zephyr/arch/openrisc/Kconfig"
osource "/Users/alfred/zephyrproject/zephyr/arch/mips/Kconfig"
osource "/Users/alfred/zephyrproject/zephyr/arch/arm64/Kconfig"
osource "/Users/alfred/zephyrproject/zephyr/arch/arm/Kconfig"
osource "/Users/alfred/zephyrproject/zephyr/arch/arc/Kconfig"
```

## build/Kconfig/arch/Kconfig
```kconfig
# Load Zephyr Arch Kconfig descriptions.
osource "/Users/davidhellstrom/EmbeddedSystems/zephyrproject/zephyr/arch/rx/Kconfig"
osource "/Users/davidhellstrom/EmbeddedSystems/zephyrproject/zephyr/arch/x86/Kconfig"
osource "/Users/davidhellstrom/EmbeddedSystems/zephyrproject/zephyr/arch/xtensa/Kconfig"
osource "/Users/davidhellstrom/EmbeddedSystems/zephyrproject/zephyr/arch/sparc/Kconfig"
osource "/Users/davidhellstrom/EmbeddedSystems/zephyrproject/zephyr/arch/riscv/Kconfig"
osource "/Users/davidhellstrom/EmbeddedSystems/zephyrproject/zephyr/arch/posix/Kconfig"
osource "/Users/davidhellstrom/EmbeddedSystems/zephyrproject/zephyr/arch/openrisc/Kconfig"
osource "/Users/davidhellstrom/EmbeddedSystems/zephyrproject/zephyr/arch/mips/Kconfig"
osource "/Users/davidhellstrom/EmbeddedSystems/zephyrproject/zephyr/arch/arm64/Kconfig"
osource "/Users/davidhellstrom/EmbeddedSystems/zephyrproject/zephyr/arch/arm/Kconfig"
osource "/Users/davidhellstrom/EmbeddedSystems/zephyrproject/zephyr/arch/arc/Kconfig"
```

## build/Kconfig/boards/Kconfig.defconfig
```kconfig
# Load Zephyr board defconfig descriptions.
osource "/Users/davidhellstrom/EmbeddedSystems/zephyrproject/zephyr/boards/raspberrypi/rpi_pico2/Kconfig.defconfig"
```

## build/Kconfig/boards/Kconfig.sysbuild.tmp
```kconfig
# Load Sysbuild board Kconfig descriptions.
osource "/Users/davidhellstrom/EmbeddedSystems/zephyrproject/zephyr/boards/raspberrypi/rpi_pico2/Kconfig.sysbuild"
```

## build/Kconfig/boards/Kconfig.tmp
```kconfig
# Load Zephyr board Kconfig descriptions.
osource "/Users/davidhellstrom/EmbeddedSystems/zephyrproject/zephyr/boards/raspberrypi/rpi_pico2/Kconfig"
```

## light-sensor/build/Kconfig/arch/Kconfig
```kconfig
# Load Zephyr Arch Kconfig descriptions.
osource "/home/gufri/dev/zephyrproject/zephyr/arch/rx/Kconfig"
osource "/home/gufri/dev/zephyrproject/zephyr/arch/x86/Kconfig"
osource "/home/gufri/dev/zephyrproject/zephyr/arch/xtensa/Kconfig"
osource "/home/gufri/dev/zephyrproject/zephyr/arch/sparc/Kconfig"
osource "/home/gufri/dev/zephyrproject/zephyr/arch/riscv/Kconfig"
osource "/home/gufri/dev/zephyrproject/zephyr/arch/posix/Kconfig"
osource "/home/gufri/dev/zephyrproject/zephyr/arch/openrisc/Kconfig"
osource "/home/gufri/dev/zephyrproject/zephyr/arch/mips/Kconfig"
osource "/home/gufri/dev/zephyrproject/zephyr/arch/arm64/Kconfig"
osource "/home/gufri/dev/zephyrproject/zephyr/arch/arm/Kconfig"
osource "/home/gufri/dev/zephyrproject/zephyr/arch/arc/Kconfig"
```

## light-sensor/build/Kconfig/boards/Kconfig.defconfig.tmp
```kconfig
# Load Zephyr board defconfig descriptions.
osource "/home/gufri/dev/zephyrproject/zephyr/boards/raspberrypi/rpi_pico2/Kconfig.defconfig"
```

## light-sensor/build/Kconfig/boards/Kconfig.rpi_pico2.tmp
```kconfig
# Load board Kconfig descriptions.
osource "/home/gufri/dev/zephyrproject/zephyr/boards/raspberrypi/rpi_pico2/Kconfig.rpi_pico2"
```

## light-sensor/build/Kconfig/boards/Kconfig.sysbuild.tmp
```kconfig
# Load Sysbuild board Kconfig descriptions.
osource "/home/gufri/dev/zephyrproject/zephyr/boards/raspberrypi/rpi_pico2/Kconfig.sysbuild"
```

## sensor_node/build/Kconfig/boards/Kconfig.rpi_pico2.tmp
```kconfig
# Load board Kconfig descriptions.
osource "/Users/alfred/zephyrproject/zephyr/boards/raspberrypi/rpi_pico2/Kconfig.rpi_pico2"
```
